/*
 * esp32_cooling_system.ino
 * ─────────────────────────────────────────────────────────────────────────
 * Canine Heat Stroke Prevention System — Blynk IoT Edition
 * Thesis: "IoT Monitoring of Vital Signs and Active Cooling for
 *          Canine Heat Stroke Prevention Using Binary Classification"
 *
 * ── Hardware ──────────────────────────────────────────────────────────────
 *   ESP32 development board
 *   DS18B20  waterproof probe  → body temperature  (GPIO4, OneWire)
 *   DHT22    sensor            → environmental temperature (GPIO5)
 *   Piezoelectric disc/film    → respiratory rate   (GPIO35 = ADC1_CH7)
 *     Piezo(+) ── GPIO35 ── [1 MΩ to GND]   (1 MΩ in parallel with piezo)
 *     Piezo(−) ── GND
 *   2-channel relay module     → Channel 1: Peltier module (GPIO25)
 *                                Channel 2: Cooling fans   (GPIO26)
 *
 * ── Required Arduino libraries (Library Manager) ──────────────────────────
 *   OneWire      by Paul Stoffregen
 *   DallasTemperature    by Miles Burton
 *   DHT sensor library   by Adafruit
 *   Blynk        by Volodymyr Shymanskyy  (v1.3.x or newer)
 *
 * ── ML model header ───────────────────────────────────────────────────────
 *   Run  python export_model.py  → copy canine_model.h into this folder.
 *
 * ── Blynk dashboard virtual pins ─────────────────────────────────────────
 *   V0  Body temperature    (°C)    — Gauge, 36.5–42
 *   V1  Respiratory rate   (bpm)   — Gauge, 0–70
 *   V2  environmental temperature (°C)   — Gauge, 15–45
 *   V4  ML result           (0/1)  — LED/Value, 0=Normal 1=HeatStressed
 *   V5  Cooling state      (0–3)  — Value, 0=NORMAL 1=STRESSED 2=COOL_P 3=COOL_F
 *
 * ── Data logging ──────────────────────────────────────────────────────────
 *   Every 60 s the ESP32 POSTs a JSON record to a Google Apps Script web
 *   app, which appends a row to a Google Sheet. That sheet is your live
 *   training dataset.  See README / project report for setup instructions.
 *
 * ── Cooling state machine ─────────────────────────────────────────────────
 *   NORMAL ──(≥2 sensors stressed)──► HEAT_STRESSED
 *                                        │
 *                               (all readings return to normal)
 *                                        ▼
 *                                COOLDOWN_PELTIER  [60 s — Peltier+Fan ON]
 *                                        │  (60 s elapsed)
 *                                        ▼
 *                                COOLDOWN_FAN  [120 s — Fan only ON]
 *                                        │  (120 s elapsed)
 *                                        ▼
 *                                     NORMAL
 *   Any cooldown + stress re-detected → immediately back to HEAT_STRESSED.
 */

// ═══════════════════════════════════════════════════════════════════════════
//  BLYNK CREDENTIALS  —  must come before any #include
//  Fill in from your Blynk Console (cloud.blynk.io → Templates → Device)
// ═══════════════════════════════════════════════════════════════════════════
#define BLYNK_TEMPLATE_ID    "TMPL6ON4E1cJ3"           // e.g. "TMPL4tXxxxxxx"
#define BLYNK_TEMPLATE_NAME  "Canine Cooling System"
#define BLYNK_AUTH_TOKEN     "agAVZhjCKKq8kUqQr-3hBbVFFZn55hzh"  // 32-char token from Blynk console
// Comment out the next line after initial testing to reduce Serial noise:
#define BLYNK_PRINT          Serial

// ═══════════════════════════════════════════════════════════════════════════
//  INCLUDES
// ════════════════════════════════════════════════════════════════════ ═══════
#include <WiFi.h>
#include <BlynkSimpleEsp32.h>   // pulls in WiFiClient internally
#include <WiFiClientSecure.h>
#include <HTTPClient.h>
#include <time.h>

#include <OneWire.h>
#include <DallasTemperature.h>
#include <DHT.h>
#include "canine_model.h"       // generated by export_model.py

// ═══════════════════════════════════════════════════════════════════════════
//  NETWORK CREDENTIALS  —  fill in your own
// ═══════════════════════════════════════════════════════════════════════════
const char* WIFI_SSID = "Galaxy A72AA03";
const char* WIFI_PASS = "gddu5648";

// Google Apps Script web-app URL for data logging to Google Sheets.
// See Section 2 of the technical guide for how to create and deploy this.
const char* SHEETS_URL = "https://script.google.com/macros/s/AKfycby5PRPnGOw_gBy5StMGmMqwtaCMhk8fS5BBxXRGNQNFwnslAkitmCWIJr4U2FGz6mcH/exec";

// ═══════════════════════════════════════════════════════════════════════════
//  HARDWARE PIN ASSIGNMENTS
// ═══════════════════════════════════════════════════════════════════════════
#define DS18B20_PIN        4
#define DHT_PIN            5
#define DHT_TYPE           DHT22
#define RESP_ADC_PIN       35   // GPIO35 = ADC1_CH7
#define PELTIER_RELAY_PIN  25
#define FAN_RELAY_PIN      26
#define STATUS_LED_PIN     2    // built-in LED

// ── Relay polarity ────────────────────────────────────────────────────────
#define RELAY_ON   LOW    // active-LOW relay module (most common)
#define RELAY_OFF  HIGH   // swap both if your module is active-HIGH

// ═══════════════════════════════════════════════════════════════════════════
//  TIMING
// ═══════════════════════════════════════════════════════════════════════════
#define PELTIER_HOLD_MS      60000UL  // hold Peltier ON 60 s after readings normalise
#define FAN_HOLD_MS         120000UL  // hold fans ON  120 s after Peltier turns off
#define SENSOR_SAMPLE_MS      2000UL  // body/environmental read cycle

// Blynk timers (BlynkTimer is non-blocking — safe alongside cooling logic)
#define BLYNK_DASHBOARD_MS   30000L   // push to Blynk dashboard every 30 s
#define SHEETS_LOG_MS        60000L   // log to Google Sheets every 60 s

// ═══════════════════════════════════════════════════════════════════════════
//  RESPIRATORY RATE — ADC PEAK DETECTION
// ═══════════════════════════════════════════════════════════════════════════
//  GPIO35 is polled at 50 Hz. Three-stage algorithm:
//    1. EMA filter  — removes 50/60 Hz mains noise from long piezo wires
//    2. Dynamic window — auto-tracks signal peak and floor; no manual tuning
//    3. Median BPM  — ignores single outlier detections; no BPM spikes
//
//  RESP_MIN_RANGE_ADC calibration (Serial Plotter):
//    1. Uncomment  #define DEBUG_RESP_PLOTTER  below
//    2. Upload → open Serial Plotter (Ctrl+Shift+L)
//    3. Breathing normally with piezo on chest: watch sig vs thresh lines.
//       - No detection triggering? Lower RESP_MIN_RANGE_ADC (more sensitive).
//       - Noise triggering false peaks? Raise RESP_MIN_RANGE_ADC (less sensitive).
//    4. Recomment the define when calibrated.
//
#define RESP_MIN_RANGE_ADC   50        // min peak-to-peak ADC counts to enable detection
#define RESP_SAMPLE_MS        20UL     // ADC poll interval = 50 Hz
#define RESP_REFRACTORY_MS  450UL     // min ms between detected peaks (~133 bpm max)
#define RESP_MAX_INTERVAL  9000UL     // max plausible ms per breath (6.7 bpm min)
#define RESP_HISTORY          6        // ring buffer size; median of last 6 intervals
// #define DEBUG_RESP_PLOTTER            // uncomment for Serial Plotter calibration

// ═══════════════════════════════════════════════════════════════════════════
//  SENSOR OBJECTS
// ═══════════════════════════════════════════════════════════════════════════
OneWire           oneWire(DS18B20_PIN);
DallasTemperature bodyTempSensor(&oneWire);
DHT               dht(DHT_PIN, DHT_TYPE);

// ═══════════════════════════════════════════════════════════════════════════
//  RESPIRATORY ADC STATE  (private)
// ═══════════════════════════════════════════════════════════════════════════
static unsigned long _rLastSampleMs  = 0;
static float         _rEMA           = 0.0f;
static bool          _rPeakArmed     = true;
static unsigned long _rLastBreathMs  = 0;
static unsigned long _rIntvl[RESP_HISTORY];
static uint8_t       _rIdx           = 0;
static uint8_t       _rCount         = 0;
static float         _rBPM           = 15.0f;   // default = mid-normal range

// ═══════════════════════════════════════════════════════════════════════════
//  SHARED SENSOR CACHE
//  Updated by the 2-second sensor cycle; read by Blynk and Sheets timers
//  so they never trigger a blocking sensor re-read.
// ═══════════════════════════════════════════════════════════════════════════
float g_bodyTemp    = 38.7f;
float g_environmentalTemp = 25.0f;
float g_respRate    = 15.0f;
int   g_prediction  = 0;

// ═══════════════════════════════════════════════════════════════════════════
//  COOLING STATE MACHINE
// ═══════════════════════════════════════════════════════════════════════════
enum CoolingState : uint8_t {
  STATE_NORMAL,
  STATE_HEAT_STRESSED,
  STATE_COOLDOWN_PELTIER,
  STATE_COOLDOWN_FAN
};
const char* stateName(CoolingState s);   // forward declaration

CoolingState  coolingState   = STATE_NORMAL;
unsigned long cooldownTimer  = 0;
unsigned long lastSensorRead = 0;

// ── BlynkTimer (non-blocking scheduler, replaces delay()) ─────────────────
BlynkTimer blynkTimer;

// ═══════════════════════════════════════════════════════════════════════════
//  RELAY / LED HELPERS
// ═══════════════════════════════════════════════════════════════════════════
inline void setPeltier(bool on) { digitalWrite(PELTIER_RELAY_PIN, on ? RELAY_ON : RELAY_OFF); }
inline void setFan    (bool on) { digitalWrite(FAN_RELAY_PIN,     on ? RELAY_ON : RELAY_OFF); }

void activateCooling() { setPeltier(true);  setFan(true);  digitalWrite(STATUS_LED_PIN, HIGH); }
void deactivateCooling() { setPeltier(false); setFan(false); digitalWrite(STATUS_LED_PIN, LOW);  }

const char* stateName(CoolingState s) {
  switch (s) {
    case STATE_NORMAL:           return "NORMAL";
    case STATE_HEAT_STRESSED:    return "HEAT_STRESSED";
    case STATE_COOLDOWN_PELTIER: return "COOLDOWN_PELTIER";
    case STATE_COOLDOWN_FAN:     return "COOLDOWN_FAN";
    default:                     return "UNKNOWN";
  }
}

// ═══════════════════════════════════════════════════════════════════════════
//  RESPIRATORY RATE — ADC PEAK DETECTION
// ═══════════════════════════════════════════════════════════════════════════

static inline int adcAvg4() {
  return (analogRead(RESP_ADC_PIN) + analogRead(RESP_ADC_PIN) +
          analogRead(RESP_ADC_PIN) + analogRead(RESP_ADC_PIN)) >> 2;
}

// Call from top of loop() on every iteration (self-limits to 50 Hz internally).
// Call from top of loop() on every iteration (self-limits to 50 Hz internally).
void sampleRespRate() {
  unsigned long now = millis();
  if (now - _rLastSampleMs < RESP_SAMPLE_MS) return;
  _rLastSampleMs = now;

  // Stage 1 - Raw ADC with light denoising (Trusting adcAvg4() for heavy lifting)
  int raw = adcAvg4();
  // Raised alpha to 0.45 to prevent peak-flattening while stripping high frequency hum
  _rEMA = 0.45f * (float)raw + 0.55f * _rEMA;
  float sig = _rEMA;

  // Stage 2 - Slower Dynamic Window Decay (Lasts ~6-8 seconds instead of 1 second)
  static float _dMax = 0.0f, _dMin = 4095.0f;
  _dMax = _dMax * 0.9975f;
  _dMin = _dMin * 1.0025f;
  if (sig > _dMax) _dMax = sig;
  if (sig < _dMin) _dMin = sig;

  // Stage 3 - Range guard
  float range = _dMax - _dMin;
  if (range < (float)RESP_MIN_RANGE_ADC) return;

  float thresh    = _dMin + range * 0.60f; // Adjusted for better peak sensitivity
  float threshLow = _dMin + range * 0.35f;

  // Stage 4 - Rising-edge peak detection
  if (_rPeakArmed && sig >= thresh) {
    if (_rLastBreathMs != 0) {
      unsigned long gap = now - _rLastBreathMs;
      if (gap >= RESP_REFRACTORY_MS && gap <= RESP_MAX_INTERVAL) {
        
        // Save interval to ring buffer
        _rIntvl[_rIdx % RESP_HISTORY] = gap;
        _rIdx++;
        if (_rCount < RESP_HISTORY) _rCount++;

        // Process BPM inside the true valid breath condition block
        if (_rCount >= 3) {
          // Stage 5 — Median filter calculation
          unsigned long buf[RESP_HISTORY];
          uint8_t n = _rCount;
          for (uint8_t i = 0; i < n; i++) buf[i] = _rIntvl[i];
          
          for (int i = 1; i < (int)n; i++) { // Insertion sort
            unsigned long key = buf[i];
            int j = i - 1;
            while (j >= 0 && buf[j] > key) { buf[j + 1] = buf[j]; j--; }
            buf[j + 1] = key;
          }
          
          unsigned long med = (n % 2 == 0)
                              ? (buf[n / 2 - 1] + buf[n / 2]) / 2
                              : buf[n / 2];
          
          float rawBPM = 60000.0f / (float)med;
          _rBPM = _rBPM * 0.75f + rawBPM * 0.25f; 
        }
      }
    }
    // CRITICAL FIX: These variables must only reset when a peak event triggers
    _rLastBreathMs = now;
    _rPeakArmed = false; 

  } else if (!_rPeakArmed && sig < threshLow) {
    _rPeakArmed = true;  // Re-arm when signal clears the baseline threshold
  }

#ifdef DEBUG_RESP_PLOTTER
  Serial.print(sig);      Serial.print(",");
  Serial.print(thresh);   Serial.print(",");
  Serial.println(threshLow);
#endif
}

float getLatestRespRate() { return _rBPM; }

// ═══════════════════════════════════════════════════════════════════════════
//  TEMPERATURE SENSOR READS
// ═══════════════════════════════════════════════════════════════════════════

float readBodyTemp() {
  bodyTempSensor.requestTemperatures();
  float t = bodyTempSensor.getTempCByIndex(0);
  // DEVICE_DISCONNECTED_C = -127 (CRC fail / no device)
  // 85.0 = DS18B20 power-on reset value — reject both
  if (t == DEVICE_DISCONNECTED_C || t == 85.0f) return -1.0f;
  return t;
}

float readenvironmentalTemp() {
  float t = dht.readTemperature();
  return isnan(t) ? -1.0f : t;
}

// ═══════════════════════════════════════════════════════════════════════════
//  NTP TIMESTAMP HELPER
// ═══════════════════════════════════════════════════════════════════════════

String getTimestamp() {
  time_t now = time(nullptr);
  if (now < 1700000000UL) return "TIME_NOT_SYNCED";
  struct tm* t = localtime(&now);
  char buf[25];
  strftime(buf, sizeof(buf), "%Y-%m-%d %H:%M:%S", t);
  return String(buf);
}

// ═══════════════════════════════════════════════════════════════════════════
//  BLYNK DASHBOARD UPDATE  (called by blynkTimer every 30 s)
//  Reads from the shared sensor cache — never triggers a blocking sensor read.
// ═══════════════════════════════════════════════════════════════════════════

void sendBlynkData() {
  if (!Blynk.connected()) return;
  Blynk.virtualWrite(V0, g_bodyTemp);
  Blynk.virtualWrite(V1, g_respRate);
  Blynk.virtualWrite(V2, g_environmentalTemp);
  Blynk.virtualWrite(V4, g_prediction);
  Blynk.virtualWrite(V5, (int)coolingState);
}

// ═══════════════════════════════════════════════════════════════════════════
//  GOOGLE SHEETS DATA LOG  (called by blynkTimer every 60 s)
//  POSTs a JSON record to the Google Apps Script web app.
// ═══════════════════════════════════════════════════════════════════════════

void sendSheetsData() {
  if (WiFi.status() != WL_CONNECTED) return;

  // Build compact JSON payload (without humidity field)
  String json = "{\"ts\":\""    + getTimestamp()               + "\","
              + "\"bt\":"     + String(g_bodyTemp, 2)        + ","
              + "\"rr\":"     + String(g_respRate, 1)        + ","
              + "\"at\":"     + String(g_environmentalTemp, 2)     + ","
              + "\"pred\":"   + String(g_prediction)         + ","
              + "\"state\":"  + String((int)coolingState)    + "}";

  WiFiClientSecure client;
  client.setInsecure();    // acceptable for academic data logging
  HTTPClient http;
  http.begin(client, SHEETS_URL);
  http.addHeader("Content-Type", "application/json");
  http.setTimeout(8000);
  http.setFollowRedirects(HTTPC_STRICT_FOLLOW_REDIRECTS);  // Google redirects on POST

  int code = http.POST(json);
  http.end();

  if (code > 0) {
    Serial.printf("[SHEETS] Row logged at %s  (HTTP %d)\n", getTimestamp().c_str(), code);
  } else {
    Serial.printf("[SHEETS] POST failed: %s\n", HTTPClient::errorToString(code).c_str());
  }
}

// ═══════════════════════════════════════════════════════════════════════════
//  COOLING STATE MACHINE UPDATE
// ═══════════════════════════════════════════════════════════════════════════

void updateCoolingState(int isStressed, unsigned long now) {
  CoolingState prev = coolingState;

  switch (coolingState) {
    case STATE_NORMAL:
      if (isStressed) { coolingState = STATE_HEAT_STRESSED; activateCooling(); }
      break;
    case STATE_HEAT_STRESSED:
      if (!isStressed) { coolingState = STATE_COOLDOWN_PELTIER; cooldownTimer = now; }
      break;
    case STATE_COOLDOWN_PELTIER:
      if (isStressed) {
        coolingState = STATE_HEAT_STRESSED;
      } else if (now - cooldownTimer >= PELTIER_HOLD_MS) {
        coolingState = STATE_COOLDOWN_FAN; cooldownTimer = now; setPeltier(false);
      }
      break;
    case STATE_COOLDOWN_FAN:
      if (isStressed) {
        coolingState = STATE_HEAT_STRESSED; activateCooling();
      } else if (now - cooldownTimer >= FAN_HOLD_MS) {
        coolingState = STATE_NORMAL; deactivateCooling();
      }
      break;
  }

  if (coolingState != prev) {
    Serial.printf("\n[STATE] %s  →  %s\n", stateName(prev), stateName(coolingState));
    switch (coolingState) {
      case STATE_HEAT_STRESSED:    Serial.println("  Peltier ON + Fans ON"); break;
      case STATE_COOLDOWN_PELTIER: Serial.printf("  Peltier+Fans ON for %lu s.\n", PELTIER_HOLD_MS/1000); break;
      case STATE_COOLDOWN_FAN:     Serial.printf("  Peltier OFF. Fans ON for %lu s.\n", FAN_HOLD_MS/1000); break;
      case STATE_NORMAL:           Serial.println("  Cooldown complete. All cooling OFF."); break;
    }
  }
}

// ═══════════════════════════════════════════════════════════════════════════
//  SETUP
// ═══════════════════════════════════════════════════════════════════════════
#include "soc/soc.h"
#include "soc/rtc_cntl_reg.h"

void setup() {
  WRITE_PERI_REG(RTC_CNTL_BROWN_OUT_REG, 0); // Disable brownout detector
  Serial.begin(115200);
  delay(500);
  Serial.println(F("\n=========================================="));
  Serial.println(F("  Canine Heat Stroke Prevention System  "));
  Serial.println(F("=========================================="));

  // Actuators — safe default at boot
  pinMode(PELTIER_RELAY_PIN, OUTPUT);
  pinMode(FAN_RELAY_PIN,     OUTPUT);
  pinMode(STATUS_LED_PIN,    OUTPUT);
  deactivateCooling();

  // ADC for piezoelectric respiratory sensor (full 0–3.3 V range)
  analogSetWidth(12);
#ifdef ADC_ATTEN_DB_12
  analogSetPinAttenuation(RESP_ADC_PIN, ADC_ATTEN_DB_12);  // ESP32 Arduino core v3.x
#else
  analogSetPinAttenuation(RESP_ADC_PIN, ADC_11db);          // core v2.x
#endif

  // Temperature sensors
  bodyTempSensor.begin();
  dht.begin();
  {
    int dsCount = bodyTempSensor.getDeviceCount();
    Serial.printf("[DS18B20] %d device(s) found on OneWire bus (GPIO%d)\n", dsCount, DS18B20_PIN);
    if (dsCount == 0) {
      Serial.println(F("[DS18B20] *** NO SENSOR DETECTED ***"));
      Serial.println(F("  Most likely cause: missing 4.7kΩ pull-up resistor."));
      Serial.println(F("  FIX: connect a 4.7kΩ resistor from GPIO4 to 3.3V."));
      Serial.println(F("  DS18B20 pinout (flat face toward you): GND | DATA | VCC(3.3V)"));
    }
  }

  // Pre-fill ring buffer with a plausible mid-normal interval (2 000 ms = 30 bpm)
  for (int i = 0; i < RESP_HISTORY; i++) _rIntvl[i] = 2000;

  // ── WiFi (non-blocking with 10 s timeout) ─────────────────────────────
  Serial.print(F("Connecting to WiFi"));
  WiFi.begin(WIFI_SSID, WIFI_PASS);
  for (int i = 0; i < 20 && WiFi.status() != WL_CONNECTED; i++) {
    delay(500); Serial.print('.');
  }
  Serial.println();

  if (WiFi.status() == WL_CONNECTED) {
    Serial.printf("WiFi OK — IP: %s\n", WiFi.localIP().toString().c_str());

    // NTP time sync — UTC+8 (Philippines)
    configTime(8 * 3600, 0, "pool.ntp.org", "time.nist.gov");
    Serial.print(F("Syncing NTP"));
    for (int i = 0; i < 20 && time(nullptr) < 1700000000UL; i++) {
      delay(500); Serial.print('.');
    }
    Serial.println();

    // Blynk (6 s connect timeout — won't block if server unreachable)
    Blynk.config(BLYNK_AUTH_TOKEN);
    if (Blynk.connect(6000)) {
      Serial.println(F("[BLYNK] Connected to Blynk cloud server."));
    } else {
      Serial.println(F("[BLYNK] Initial connect timed out — will auto-retry in background."));
      Serial.println(F("[BLYNK] Check: BLYNK_TEMPLATE_ID and AUTH_TOKEN match Blynk Console."));
      Serial.println(F("[BLYNK] App: use 'Blynk IoT' (new), NOT 'Blynk Legacy' (old)."));
    }

    // Schedule non-blocking periodic tasks via BlynkTimer
    blynkTimer.setInterval(BLYNK_DASHBOARD_MS, sendBlynkData);   // 30 s
    blynkTimer.setInterval(SHEETS_LOG_MS,      sendSheetsData);  // 60 s

    Serial.println(F("Blynk + Sheets logging active."));
  } else {
    Serial.println(F("WiFi unavailable — running in OFFLINE mode (cooling logic unaffected)."));
  }

  Serial.println(F("\nAll sensors ready. Monitoring started.\n"));

#ifndef DEBUG_RESP_PLOTTER
  Serial.println(F("BodyTemp(C)  RespRate(bpm)  environmental(C)  State                 Result         Cooldown"));
  Serial.println(F("─────────────────────────────────────────────────────────────────────────────────────────────"));
  #else
  Serial.println(F("[PLOTTER MODE] filtered_ADC | threshold | re-arm_level"));
#endif
}

// ═══════════════════════════════════════════════════════════════════════════
//  MAIN LOOP
// ═══════════════════════════════════════════════════════════════════════════

void loop() {
  // ── 1. Respiratory ADC — must run on every iteration (50 Hz) ─────────────
  sampleRespRate();

  // ── 2. Blynk keep-alive and non-blocking timer dispatch ───────────────────
  if (WiFi.status() == WL_CONNECTED) {
    Blynk.run();
    blynkTimer.run();
  }

  // ── 3. 2-second sensor + classification cycle ─────────────────────────────
  unsigned long now = millis();
  if (now - lastSensorRead < SENSOR_SAMPLE_MS) return;
  lastSensorRead = now;

  float bodyTemp    = readBodyTemp();
  float environmentalTemp = readenvironmentalTemp();
  float respRate    = getLatestRespRate();

  // Update resp rate immediately — always pushed to Blynk V1 even if other sensors fail
  g_respRate = respRate;

  Serial.printf("[DEBUG] Body: %.2f C | Resp: %.1f bpm | Environmental: %.2f C\n",
                bodyTemp, respRate, environmentalTemp);

  if (bodyTemp < 0.0f) {
    Serial.println(F("[WARN] DS18B20 returned -127C (disconnected / CRC fail)."));
    Serial.println(F("       >> Add 4.7kΩ resistor: GPIO4 ──[4.7kΩ]── 3.3V <<"));
    return;
  }
  if (environmentalTemp < 0.0f) {
    Serial.println(F("[WARN] DHT22 read failed — check DATA wire to GPIO5."));
    return;
  }

  // Update shared cache so Blynk/Sheets timers read fresh values
  g_bodyTemp          = bodyTemp;
  g_environmentalTemp = environmentalTemp;
  // g_respRate already updated above (before sensor checks)

  int prediction  = classify(bodyTemp, respRate, environmentalTemp);
  g_prediction    = prediction;

  updateCoolingState(prediction, now);

#ifndef DEBUG_RESP_PLOTTER
  unsigned long elapsed = 0, target = 0;
  if (coolingState == STATE_COOLDOWN_PELTIER || coolingState == STATE_COOLDOWN_FAN) {
    elapsed = (now - cooldownTimer) / 1000UL;
    target  = (coolingState == STATE_COOLDOWN_PELTIER) ? PELTIER_HOLD_MS/1000 : FAN_HOLD_MS/1000;
  }
  char cdBuf[20] = "-";
  if (target) snprintf(cdBuf, sizeof(cdBuf), "%lus/%lus", elapsed, target);

  Serial.printf("%-12.2f %-14.1f %-11.2f %-21s %-14s %s\n",
                bodyTemp, respRate, environmentalTemp,
                stateName(coolingState),
                prediction ? "HEAT_STRESSED" : "NORMAL",
                cdBuf);
#endif
}